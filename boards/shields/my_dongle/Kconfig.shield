## boards/shields/my_dongle/Kconfig.shield
```kconfig
# No whitespace after the comma or in the keyboard name!
config MY_DONGLE
    def_bool $(shields_list_contains,my_dongle)
```

## boards/shields/my_keyboard/Kconfig.shield
```kconfig
# No whitespace after the comma or in the keyboard name!
config POSIX_SEEED_XIAO
    def_bool $(shields_list_contains,posix_seeed_xiao)
```
